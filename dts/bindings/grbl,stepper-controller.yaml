## dts/bindings/grbl,stepper-controller.yaml
```yaml
description: My Custom Stepper controller

compatible: "grbl,stepper-controller"

include: base.yaml

properties:
    timer:
        type: phandle
        required: true
        description: Reference to the hardware timer

    x-pulse-gpios:
        type: phandle-array
        required: true
        description: GPIO pin for X axis step pulse

    y-pulse-gpios:
        type: phandle-array
        required: true
        description: GPIO pin for Y axis step pulse

    z-pulse-gpios:
        type: phandle-array
        required: true
        description: GPIO pin for Z axis step pulse
  
```

## dts/bindings/xyz-pulse.yaml
```yaml
description: My Custom GRBL Driver

compatible: "my,xyz-pulse"

# 引入基礎定義
include: base.yaml

# 這裡就是「宣告變數型別」的地方
properties:
  timer-x-y:
    type: phandle      # phandle 代表它指向另一個硬體節點 (如 &timers2)
    required: true     # 強制規定一定要填寫
    description: Timer for X/Y axis

  timer-z:
    type: phandle
    required: true
    description: Timer for Z axis
```
